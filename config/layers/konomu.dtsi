
k_base {
    bindings = <
&kp BSPC   &kp F      &kp D      &kp N     &kp I     &kp G        &kp G       &kp I      &kp N        &kp D      &kp F       &kp BSPC
&kp LCTRL  &kp S      &kp T      &kp H     &kp E     &kp O        &kp O       &kp E      &kp H        &kp T      &kp S       &kp RCTRL
&kp LSHFT  &kp C      &kp W      &kp R     &kp A     &kp U        &kp U       &kp A      &kp R        &kp W      &kp C       &kp RSHFT
                                 &kp LGUI  &sl 9     &kp SPACE    &kp SPACE   &sl 9      &kp RGUI
    >;
};

k_sec {
    bindings = <
&kp TAB    &kp J     &kp K     &kp M       &kp SQT   &kp MINUS    &kp MINUS   &kp SQT     &kp M       &kp K      &kp J       &kp TAB
&kp LCTRL  &kp Y     &kp P     &kp L       &kp DOT   &kp B        &kp B       &kp DOT     &kp L       &kp P      &kp Y       &kp RCTRL
&kp LSHFT  &kp X     &kp B     &kp V       &kp COMMA &kp Z        &kp Z       &kp COMMA   &kp V       &kp B      &kp X       &kp RSHFT
                               &kp LGUI    &none     &kp RET      &kp RET     &none       &kp RGUI
    >;
};

k_num {
    bindings = <
&kp EQUAL  &kp N6    &kp N7    &kp N8      &kp N9    &kp N0       &kp N0      &kp N9      &kp N8      &kp N7     &kp N6      &kp EQUAL
&kp PLUS   &kp N1    &kp N2    &kp N3      &kp N4    &kp N5       &kp N5      &kp N4      &kp N3      &kp N2     &kp N1      &kp PLUS
&kp MINUS  &kp HASH  &kp DLLR  &kp PRCNT   &kp GRAVE &kp DOT      &kp DOT     &kp GRAVE   &kp PRCNT   &kp DLLR   &kp HASH    &kp MINUS
                               &kp LGUI    &none     &kp RET      &kp RET     &none       &kp RGUI
    >;
};

k_sym {
    bindings = <
&kp TAB    &kp LBKT  &kp LBRC  &kp LPAR   &kp AT    &kp CARET    &kp CARET   &kp AT       &kp LPAR    &kp LBRC   &kp LBKT    &kp TAB
&kp BSLH   &kp COLON &kp SEMI  &kp QMARK  &kp EXCL  &kp FSLH     &kp FSLH    &kp EXCL     &kp QMARK   &kp SEMI   &kp COLON   &kp BSLH
&kp TILDE  &kp RBKT  &kp RBRC  &kp RPAR   &kp AMPS  &kp STAR     &kp STAR    &kp AMPS     &kp RPAR    &kp RBRC   &kp RBKT    &kp TILDE
                               &kp LGUI   &none     &kp RET      &kp RET     &none        &kp RGUI
    >;
};

