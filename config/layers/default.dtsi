base {
    bindings = <
&kp TAB    &kp SQT   &kp COMMA  &kp DOT       &kp P     &kp Y        &kp F      &kp G          &kp C     &kp R  &kp L  &kp BSPC
&kp LCTRL  &kp A     &kp O      &kp E         &kp U     &kp I        &kp D      &kp H          &kp T     &kp N  &kp S  &kp RET
&kp LSHFT  &kp SEMI  &kp Q      &kp J         &kp K     &kp X        &kp B      &kp M          &kp W     &kp V  &kp Z  &kp RSHFT
                                &kp LGUI      &mo 1     &kp BSPC     &kp SPACE  &mo 1          &kp RGUI
    >;
};
symbols {
    bindings = <
&kp GRAVE       &kp N1          &kp N2           &kp N3             &kp N4          &kp N5       &kp N6     &kp N7          &kp N8    &kp N9    &kp N0    &kp TILDE
&kp UNDERSCORE  &kp EXCL        &kp AT           &kp HASH           &kp DOLLAR      &kp PERCENT  &kp CARET  &kp AMPS        &kp STAR  &kp LPAR  &kp RPAR  &kp MINUS
&mo 2           &kp PLUS        &kp QUESTION     &kp FSLH           &kp LEFT_BRACE  &kp LBKT     &kp RBKT   &kp RIGHT_BRACE &kp BSLH  &kp PIPE  &kp EQUAL &mo 2
                                                 &kp LGUI           &trans          &mo 2        &mo 2      &trans          &kp RGUI
    >;
};
