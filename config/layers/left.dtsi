l_hand {
    bindings = <
&kp BSPC   &kp S     &kp N      &kp T     &kp H     &kp D        &kp F       &kp V      &kp DOT      &kp COMMA  &kp SQT     &kp TAB
&kp LCTRL  &kp A     &kp O      &kp E     &kp U     &kp I        &kp B       &kp J      &kp K        &kp Y      &kp SEMI    &kp RCTL
&kp LSHFT  &kp L     &kp R      &kp C     &kp G     &kp P        &kp X       &kp M      &kp W        &kp Q      &kp Z       &kp RSHFT
                                &kp LGUI  &sl 5     &kp SPACE    &kp RET     &none      &kp RGUI
    >;
};
