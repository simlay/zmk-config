td_base {
    bindings = <
&kp TAB           &td_sqt_l    &td_comma_r   &td_dot_c   &td_p_g     &td_y_f        &td_f_y     &td_g_p     &td_c_dot   &td_r_comma &td_l_sqt   &kp BSPC
&kp LCTRL         &td_a_s      &td_o_n       &td_e_t     &td_u_h     &td_i_d        &td_d_i     &td_h_u     &td_t_e     &td_n_o     &td_s_a     &kp RET
&kp LSHIFT        &td_semi_z   &td_q_v       &td_j_w     &td_k_m     &td_x_b        &td_b_x     &td_m_k     &td_w_j     &td_v_q     &td_z_semi  &kp RSHIFT
                               &td_to_0      &mo 6       &kp BSPC    &kp SPACE      &mo 6     &td_to_4
    >;
};
