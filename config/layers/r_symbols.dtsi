r_symbols {
    bindings = <
    &kp TILDE    &kp N0       &kp N9      &kp N8      &kp N7             &kp N6       &kp N5         &kp N4            &kp N3      &kp N2          &kp N1      &kp GRAVE
    &kp MINUS    &kp RPAR     &kp LPAR    &kp STAR    &kp AMPS           &kp CARET    &kp PERCENT    &kp DOLLAR        &kp HASH    &kp AT          &kp EXCL    &kp UNDERSCORE
    &kp RCTRL    &kp EQUAL    &kp PIPE    &kp BSLH    &kp RIGHT_BRACE    &kp RBKT     &kp LBKT       &kp LEFT_BRACE    &kp FSLH    &kp QUESTION    &kp PLUS    &kp LCTRL
                                                      &kp LGUI           &trans       &kp SPACE       &kp SPACE        &trans      &kp RGUI
    >;
};
