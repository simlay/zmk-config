si_base {
    bindings = <
&kp BSPC   &kp S    &kp N     &kp T       &kp H     &kp D        &kp D       &kp H       &kp T       &kp N      &kp S       &kp BSPC
&kp LCTRL  &kp A    &kp O     &kp E       &kp U     &kp I        &kp I       &kp U       &kp E       &kp O      &kp A       &kp RCTRL
&kp LSHFT  &kp L    &kp R     &kp C       &kp G     &kp P        &kp P       &kp G       &kp C       &kp R      &kp L       &kp RSHFT
                              &kp LGUI    &sl 6     &kp SPACE    &kp SPACE   &sl 6       &kp RGUI
    >;
};

si_sec {
    bindings = <
&kp TAB    &kp SQT   &kp COMMA  &kp DOT   &kp V     &kp F        &kp F       &kp V      &kp DOT      &kp COMMA  &kp SQT     &kp TAB
&kp LCTRL  &kp SEMI  &kp Y      &kp K     &kp J     &kp B        &kp B       &kp J      &kp K        &kp Y      &kp SEMI    &kp RCTL
&kp LSHFT  &kp Z     &kp Q      &kp W     &kp M     &kp X        &kp X       &kp M      &kp W        &kp Q      &kp Z       &kp RSHFT
                                &kp LGUI  &none     &kp SPACE    &kp RET     &none      &kp RGUI
    >;
};
