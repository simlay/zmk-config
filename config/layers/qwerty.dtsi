qwerty {
    bindings = <
&kp TAB    &kp Q  &kp W  &kp E   &kp R         &kp T        &kp Y      &kp U         &kp I      &kp O    &kp P     &kp BSPC
&kp LCTRL  &kp A  &kp S  &kp D   &kp F         &kp G        &kp H      &kp J         &kp K      &kp L    &kp SEMI  &kp RET
&kp LSHFT  &kp Z  &kp X  &kp C   &kp V         &kp B        &kp N      &kp M         &kp COMMA  &kp DOT  &kp FSLH  &kp RSHFT
                                 &to_5      &trans       &kp SPACE  &kp SPACE      &trans     &to_0
    >;
};
